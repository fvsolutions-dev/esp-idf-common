## components/ethernet/Kconfig
```kconfig
menu "Ethernet (W5500)"
    config ETHERNET_ENABLE
        bool "Enable Ethernet driver"
        default y
        help
            Compile-time enable for the W5500-based Ethernet driver. When
            disabled, callers should skip ethernet_init() to avoid linking
            the W5500 driver.
endmenu
```

## components/influxdb_logger/Kconfig
```kconfig
menu "InfluxDB metrics logger"

    config INFLUXDB_LOGGER_LP_BUF_SIZE
        int "Line-protocol scratch buffer size (bytes)"
        default 2048
        help
            One buffer is allocated at init for the line-protocol body of a
            single POST. If your measurement has many fields or long keys you
            may need to increase this.

    config INFLUXDB_LOGGER_HTTP_TIMEOUT_MS
        int "HTTP timeout (ms)"
        default 5000

    config INFLUXDB_LOGGER_TASK_STACK
        int "Background task stack (bytes)"
        default 6144

    config INFLUXDB_LOGGER_TASK_PRIORITY
        int "Background task priority"
        default 3

    config INFLUXDB_LOGGER_TOKEN
        string "Bearer token (sent as Authorization: Token <value>)"
        default ""
        help
            Leave empty to send no Authorization header. Used unchanged for
            both http:// and https:// endpoints.

endmenu
```

## components/wifi/Kconfig
```kconfig
menu "Wi-Fi"
    config WIFI_ENABLE
        bool "Enable Wi-Fi driver"
        default y
        help
            Compile-time enable for the Wi-Fi STA driver. When disabled,
            callers should skip wifi_init() to avoid linking the Wi-Fi
            management task.
endmenu
```

## eros/eros_log/Kconfig
```kconfig
menu "EROS log"

    config EROS_LOG_PANIC_CAPTURE
        bool "Capture panic output into the RTC boot buffer"
        depends on BOOTLOADER_CUSTOM_RESERVE_RTC
        default y
        help
            Wraps the panic handler's print functions (ld --wrap) so a copy
            of the Guru Meditation dump — headline, registers, backtrace —
            lands in the same RTC region as the boot log and is replayed to
            the EROS log group on the next boot. The native UART panic
            output is untouched. Costs a few hundred bytes of IRAM for the
            wrappers.

            The region is CONFIG_BOOTLOADER_CUSTOM_RESERVE_RTC_SIZE bytes;
            a full dump plus the next boot's log can exceed it, in which
            case the tail is dropped (counted, reported at replay).

endmenu
```
